## vm/Kconfig
```kconfig
mainmenu "Picobit Virtual Machine Configuration"

choice
	prompt "Target architecture"
	help
	  Select a platform to run Picobit VM on.
	  

	config	ARCH_HOST
		bool "Host executable"
		select ARCH_32BIT
		select ERROR_HANDLING
		select DEBUG_STRINGS
		help
		  Build Picobit as a host (Linux) executable for easy
		  debugging.
		  

	config	ARCH_ARM
		bool "ARM microcontrollers"
		select ARCH_32BIT
		  

	config	ARCH_EZ80
		bool "eZ80 microcontrollers"
		select ARCH_16BIT
		select ERROR_HANDLING
endchoice

config ERROR_HANDLING
	bool

config DEBUG_STRINGS
	bool

config ARCH_8BIT
	bool

config ARCH_16BIT
	bool

config ARCH_32BIT
	bool

config ARCH
	string
	default "host" if ARCH_HOST
	default "arm" if ARCH_ARM
	default "ez80" if ARCH_EZ80

if ARCH_HOST
source "arch/host/Kconfig"
endif

if ARCH_ARM
source "arch/arm/Kconfig"
endif

if ARCH_EZ80
source "arch/ez80/Kconfig"
endif

source "core/Kconfig"
```

## vm/arch/ez80/Kconfig
```kconfig
config CROSS_COMPILER
	string "Cross compiler prefix"
	default "ez80-"

config ROM_MEM_PTR
	hex "Address where it is safe to keep a single pointer"
	# begPC = https://wikiti.brandonw.net/index.php?title=83PCE:RAM:D02317
	default D02317
```
